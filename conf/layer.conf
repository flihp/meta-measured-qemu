## conf/layer.conf
```bitbake
BBPATH .= ":${LAYERDIR}"
BBFILES += "${LAYERDIR}/recipes-*/*/*.bbappend"

BBFILE_COLLECTIONS += "measured-qemu"
BBFILE_PATTERN_measured-qemu := "^${LAYERDIR}/"
BBFILE_PRIORITY_measured-qemu = "6"
LAYERSERIES_COMPAT_measured-qemu = "sumo thud"
LAYERDEPENDS_measured-qemu = "core"
```

## conf/machine/qemux86-64-tpm-crb.conf
```bitbake
#@TYPE: Machine
#@NAME: qemux86-64-tpm-crb
#@DESCRIPTION: Machine configuration adding TPM CRB support

require conf/machine/qemux86-64.conf
```

## conf/machine/qemux86-64-tpm-tis.conf
```bitbake
#@TYPE: Machine
#@NAME: qemux86-64-tpm-tis
#@DESCRIPTION: Machine configuration adding TPM TIS support

require conf/machine/qemux86-64.conf

MACHINE_FEATURES += "tpm-tis"
```
